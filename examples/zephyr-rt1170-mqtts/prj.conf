## CMakeLists.txt
```
# MQTTS (MQTT over TLS) on RT1170-EVKB
#
# Build:
#   west build -b mimxrt1170_evk@B/mimxrt1176/cm7 -p always \
#       qt5/qtbase/examples/zephyr-rt1170-mqtts -- -DSHIELD=rk055hdmipi4ma0

cmake_minimum_required(VERSION 3.20.0)

set(CMAKE_CXX_LINK_LIBRARY_USING_WHOLE_ARCHIVE
    "LINKER:--push-state,--whole-archive"
    "<LINK_ITEM>"
    "LINKER:--pop-state")
set(CMAKE_CXX_LINK_LIBRARY_USING_WHOLE_ARCHIVE_SUPPORTED TRUE)

find_package(Zephyr REQUIRED HINTS $ENV{ZEPHYR_BASE})
project(qt_mqtts LANGUAGES CXX C)

list(APPEND CMAKE_PREFIX_PATH "$ENV{QT_ZEPHYR_PREFIX}")
find_package(Qt6 REQUIRED COMPONENTS Core Gui Widgets Network)

target_sources(app PRIVATE src/main.cpp)
target_link_libraries(app PRIVATE
    Qt6::Network
    Qt6::Widgets
    Qt6::Gui
    Qt6::Core
)
```

## prj.conf
```kconfig
# MQTTS on RT1170-EVKB
# GUI (Widgets) + Network + wolfSSL TLS + MQTT

CONFIG_QT=y
CONFIG_QT_GUI=y
CONFIG_QT_WIDGETS=y
CONFIG_QT_NETWORK=y
CONFIG_QT_WOLFSSL=y
CONFIG_QT_MQTT=y
CONFIG_QT_EMBEDDED_ROBOTO_FONT=y

# C++ / libc (Stage 1 ABI)
CONFIG_CPP=y
CONFIG_STD_CPP17=y
CONFIG_CPP_EXCEPTIONS=y
CONFIG_GLIBCXX_LIBCPP=y
CONFIG_CPP_RTTI=y
CONFIG_PICOLIBC=n
CONFIG_NEWLIB_LIBC=y
CONFIG_POSIX_API=y
CONFIG_FPU=y

# Console
CONFIG_CONSOLE=y
CONFIG_UART_CONSOLE=y
CONFIG_PRINTK=y
CONFIG_STDOUT_CONSOLE=y

# Display + touch
CONFIG_DISPLAY=y
CONFIG_INPUT=y
CONFIG_INPUT_THREAD_STACK_SIZE=32768

# PXP double-buffer + landscape rotation
CONFIG_DMA=y
CONFIG_MCUX_ELCDIF_PXP=y
CONFIG_MCUX_ELCDIF_PXP_ROTATE_90=y

# Ethernet
CONFIG_NET_L2_ETHERNET=y
CONFIG_NET_ARP=y

# IP
CONFIG_NET_DHCPV4=y
CONFIG_NET_CONFIG_SETTINGS=y
CONFIG_NET_CONFIG_NEED_IPV4=y

# Network management (DHCP event notifications)
CONFIG_NET_MGMT=y
CONFIG_NET_MGMT_EVENT=y

# Network buffers
CONFIG_NET_PKT_RX_COUNT=16
CONFIG_NET_PKT_TX_COUNT=16
CONFIG_NET_BUF_RX_COUNT=32
CONFIG_NET_BUF_TX_COUNT=32
CONFIG_NET_MAX_CONTEXTS=10

# Socket polling (Qt socket notifier uses poll())
CONFIG_ZVFS_POLL_MAX=16
CONFIG_NET_SOCKETS_POLL_MAX=16

# wolfSSL handles TLS — no mbedTLS needed

# Network logging
CONFIG_NET_LOG=y
CONFIG_LOG=y

# Entropy (CAAM disabled — fsl_caam.c ctx size error with C++ flags)
CONFIG_ENTROPY_GENERATOR=y
CONFIG_TEST_RANDOM_GENERATOR=y
CONFIG_ENTROPY_MCUX_CAAM=n

# Memory
CONFIG_HEAP_MEM_POOL_SIZE=16777216
CONFIG_NEWLIB_LIBC_ALIGNED_HEAP_SIZE=16777216
CONFIG_MAIN_STACK_SIZE=524288
CONFIG_ISR_STACK_SIZE=8192
```

## src/main.cpp
```c
#include <QApplication>
#include <QLabel>
#include <QVBoxLayout>
#include <QTimer>
#include <QSslSocket>
#include <QSslConfiguration>
#include <QSslCertificate>

#include <qmqttclient.h>

#include <zephyr/kernel.h>
#include <zephyr/net/net_if.h>
#include <zephyr/net/net_ip.h>

static const unsigned char ca_cert_der[] =
#include "ca_cert.inc"
;

static QString getZephyrIp()
{
    struct net_if *iface = net_if_get_default();
    if (!iface)
        return QStringLiteral("no iface");
    struct net_if_ipv4 *ipv4 = iface->config.ip.ipv4;
    if (!ipv4)
        return QStringLiteral("no IPv4");
    for (int i = 0; i < NET_IF_MAX_IPV4_ADDR; i++) {
        if (ipv4->unicast[i].ipv4.is_used &&
            ipv4->unicast[i].ipv4.address.in_addr.s_addr != 0) {
            char buf[NET_IPV4_ADDR_LEN];
            net_addr_ntop(AF_INET, &ipv4->unicast[i].ipv4.address.in_addr,
                          buf, sizeof(buf));
            return QString::fromLatin1(buf);
        }
    }
    return QStringLiteral("0.0.0.0");
}

int main(int /*argc_zephyr*/, char * /*argv_zephyr*/[])
{
    static char arg0[] = "mqtts";
    static char *argv[] = { arg0, nullptr };
    int argc = 1;

    qputenv("QT_QPA_PLATFORM", "zephyr");
    QApplication app(argc, argv);

    QWidget w;
    auto *layout = new QVBoxLayout(&w);
    auto *ipLabel = new QLabel("IP: waiting...");
    auto *mqttLabel = new QLabel("MQTT: not connected");
    auto *msgLabel = new QLabel("Last msg: -");
    ipLabel->setStyleSheet("font-size: 28px;");
    mqttLabel->setStyleSheet("font-size: 22px;");
    msgLabel->setStyleSheet("font-size: 20px;");
    layout->addWidget(ipLabel);
    layout->addWidget(mqttLabel);
    layout->addWidget(msgLabel);
    w.showFullScreen();

    static const QString brokerHost = QStringLiteral("192.168.1.82");
    static const quint16 brokerPort = 8883;

    QSslCertificate caCert(QByteArray(reinterpret_cast<const char *>(ca_cert_der),
                                       sizeof(ca_cert_der)), QSsl::Der);

    auto *sslSocket = new QSslSocket(&app);
    QSslConfiguration sslConfig = sslSocket->sslConfiguration();
    sslConfig.setCaCertificates({caCert});
    sslConfig.setPeerVerifyMode(QSslSocket::VerifyPeer);
    sslSocket->setSslConfiguration(sslConfig);

    auto *mqtt = new QMqttClient(&app);
    mqtt->setHostname(brokerHost);
    mqtt->setPort(brokerPort);
    mqtt->setClientId(QStringLiteral("rt1170-zephyr"));
    mqtt->setTransport(sslSocket, QMqttClient::SecureSocket);

    QObject::connect(sslSocket, &QAbstractSocket::errorOccurred, [&](QAbstractSocket::SocketError e) {
        QString detail = sslSocket->errorString().left(80);
        printk("[mqtts] socket error %d: %s\n", (int)e,
               detail.toUtf8().constData());
        mqttLabel->setText(QString("err%1: %2").arg((int)e).arg(detail));
    });

    QObject::connect(sslSocket, &QSslSocket::encrypted, [&]() {
        printk("[mqtts] TLS handshake done (wolfSSL), sending MQTT CONNECT\n");
        mqttLabel->setText(QStringLiteral("MQTT: TLS up, connecting..."));
        mqtt->connectToHost();
    });

    QObject::connect(mqtt, &QMqttClient::connected, [&]() {
        printk("[mqtts] MQTT connected!\n");
        mqttLabel->setText(QStringLiteral("MQTT: CONNECTED"));

        auto *sub = mqtt->subscribe(QMqttTopicFilter(QStringLiteral("test/zephyr")));
        QObject::connect(sub, &QMqttSubscription::messageReceived,
                         [&](const QMqttMessage &msg) {
            QString text = msg.payload().left(60);
            printk("[mqtts] recv: %s\n", text.toUtf8().constData());
            msgLabel->setText(QStringLiteral("Recv: ") + text);
        });

        mqtt->publish(QMqttTopicName(QStringLiteral("test/zephyr/status")),
                      "RT1170 online via MQTTS (wolfSSL)");
    });

    QObject::connect(mqtt, &QMqttClient::disconnected, [&]() {
        printk("[mqtts] MQTT disconnected\n");
        mqttLabel->setText(QStringLiteral("MQTT: disconnected"));
    });

    QObject::connect(mqtt, &QMqttClient::errorChanged, [&]() {
        printk("[mqtts] MQTT error: %d\n", (int)mqtt->error());
        mqttLabel->setText(QString("MQTT err: %1").arg((int)mqtt->error()));
    });

    int connectAttempt = 0;
    auto *timer = new QTimer(&app);
    QObject::connect(timer, &QTimer::timeout, [&]() {
        ipLabel->setText(QStringLiteral("IP: ") + getZephyrIp());

        if (sslSocket->state() == QAbstractSocket::UnconnectedState
            && mqtt->state() == QMqttClient::Disconnected
            && connectAttempt < 10) {
            ++connectAttempt;
            printk("[mqtts] Connecting (attempt %d)...\n", connectAttempt);
            mqttLabel->setText(QString("MQTT: connecting #%1...").arg(connectAttempt));
            sslSocket->connectToHostEncrypted(brokerHost, brokerPort);
        }
    });
    timer->start(5000);

    return app.exec();
}
```
