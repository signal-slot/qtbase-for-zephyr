## CMakeLists.txt
```
# Tier 6 example -- Qt's official Widgets Gallery (from
# qtbase/examples/widgets/gallery) running on the MIMXRT1170-EVKB +
# RK055HDMIPI4MA0 panel.
#
# Usage:
#   export ZEPHYR_BASE=~/org/zephyrproject/zephyrproject/zephyr
#   export QT_ZEPHYR_PREFIX=~/qt-zephyr-rt1170
#   export QT_ZEPHYR_SOURCE=$PWD/../../qt5/qtbase
#   west build -b mimxrt1170_evk@B/mimxrt1176/cm7 -p always \
#     examples/zephyr-rt1170-widgets-gallery -- -DSHIELD=rk055hdmipi4ma0
#   west flash --runner linkserver
#   # press SW4 to reboot from QSPI

cmake_minimum_required(VERSION 3.20.0)
find_package(Zephyr REQUIRED HINTS $ENV{ZEPHYR_BASE})
project(qt_zephyr_rt1170_widgets_gallery LANGUAGES CXX C)

set(CMAKE_PREFIX_PATH "$ENV{QT_ZEPHYR_PREFIX}" ${CMAKE_PREFIX_PATH})

# This example lives inside qtbase; the source root is two levels up.
set(QT_QTBASE_SOURCE "${CMAKE_CURRENT_SOURCE_DIR}/../..")

find_package(Qt6 REQUIRED COMPONENTS Core Gui Widgets)

set_property(TARGET Qt6::Core    PROPERTY INTERFACE_COMPILE_FEATURES "")
set_property(TARGET Qt6::Gui     PROPERTY INTERFACE_COMPILE_FEATURES "")
set_property(TARGET Qt6::Widgets PROPERTY INTERFACE_COMPILE_FEATURES "")

# Stage 1 was built with -fno-short-enums; match it across the app TUs.
zephyr_compile_options(-fno-short-enums)

# QEventDispatcherZephyr and WidgetGallery both declare Q_OBJECT -- moc
# must run on each compilation unit so the vtable's metaObject() /
# qt_metacast() / qt_metacall() anchors get emitted.
set_target_properties(app PROPERTIES AUTOMOC ON)

target_sources(app PRIVATE
    src/main.cpp

    # Qt's stock WidgetGallery widget tree (lifted verbatim from
    # qtbase/examples/widgets/gallery/widgetgallery.{h,cpp}).  AUTOMOC
    # generates the moc TU for the Q_OBJECT class.
    src/widgetgallery.cpp

    # libc / Qt-internal stubs shared with earlier Tier 2/3 examples.
    src/posix_stubs.c
    src/qt_zephyr_stubs.cpp

    # Embedded TTF (Roboto-Regular, 350KB) -- main.cpp registers it
    # via QFontDatabase::addApplicationFontFromData.
    src/embedded_font.c

    # Force the qzephyr plugin's QZephyrIntegrationPlugin symbols out
    # of libqzephyr.a into the final ELF, and pre-set
    # QT_QPA_PLATFORM=zephyr before main().
    src/plugin_import.cpp

    # Strong impls of the qzephyr_display_* weak hooks declared in
    # qzephyrbackingstore.cpp / qzephyrscreen.cpp.  Pulls in
    # <zephyr/drivers/display.h>.
    src/qzephyr_display_zephyr.cpp

    # GT911 capacitive touch -> QWindowSystemInterface mouse events.
    src/qzephyr_touch_zephyr.cpp

    # Stage-1 deferred Zephyr-runtime event dispatcher.
    "${QT_QTBASE_SOURCE}/src/corelib/kernel/qeventdispatcher_zephyr.cpp"
)

file(GLOB QT_PRIVATE_VERSION_DIR
    LIST_DIRECTORIES TRUE
    "$ENV{QT_ZEPHYR_PREFIX}/include/QtCore/[0-9]*.[0-9]*.[0-9]*")
list(GET QT_PRIVATE_VERSION_DIR 0 QT_PRIVATE_VERSION_DIR)

target_include_directories(app PRIVATE
    "$ENV{QT_ZEPHYR_PREFIX}/include"
    "$ENV{QT_ZEPHYR_PREFIX}/include/QtCore"
    "$ENV{QT_ZEPHYR_PREFIX}/include/QtGui"
    "$ENV{QT_ZEPHYR_PREFIX}/include/QtWidgets"
    "${QT_PRIVATE_VERSION_DIR}"
    "${QT_PRIVATE_VERSION_DIR}/QtCore"
    # qpa/* private headers used by the touch hook.
    "$ENV{QT_ZEPHYR_PREFIX}/include/QtGui/6.11.0/QtGui"
)

# Link the qzephyr platform plugin static archive ahead of Qt6::Gui so
# its strong symbols (QZephyrIntegrationPlugin etc.) get pulled in.
# Order: Widgets -> Gui -> Core for symbol resolution.
target_link_libraries(app PRIVATE
    "$ENV{QT_ZEPHYR_PREFIX}/plugins/platforms/libqzephyr.a"
    Qt6::Widgets
    Qt6::Gui
    Qt6::Core
)

zephyr_link_libraries(
    "-Wl,--unresolved-symbols=ignore-all"
    "-Wl,--warn-unresolved-symbols"
)
```

## prj.conf
```kconfig
# Tier 6 prj.conf -- Qt official Widgets Gallery.  Same baseline as the
# Tier 3 GUI example, with bumped heap and stack because the gallery
# instantiates a deeper widget tree (QDialog + several QGroupBox +
# QTabWidget + QToolBox + QProgressBar + QTextBrowser + a
# QStandardItemModel-backed QListView / QTableView / QTreeView).

# C++ baseline (matches Stage 1 ABI).
CONFIG_CPP=y
CONFIG_STD_CPP17=y
CONFIG_CPP_EXCEPTIONS=y
CONFIG_GLIBCXX_LIBCPP=y
CONFIG_CPP_RTTI=y

# Force newlib for ABI parity with Stage 1.
CONFIG_PICOLIBC=n
CONFIG_NEWLIB_LIBC=y

CONFIG_POSIX_API=y

# Hard-float -- Stage 1 was built with -mfpu=fpv5-d16 -mfloat-abi=hard.
CONFIG_FPU=y

# Console.
CONFIG_CONSOLE=y
CONFIG_UART_CONSOLE=y
CONFIG_PRINTK=y
CONFIG_STDOUT_CONSOLE=y

# Display subsystem (RK055HDMIPI4MA0 shield activated via
# -DSHIELD=rk055hdmipi4ma0 on the west build line).
CONFIG_DISPLAY=y

# Input subsystem -- GT911 touch driver from the shield.
CONFIG_INPUT=y

# Zephyr's input subsystem runs registered callbacks on a dedicated
# thread (CONFIG_INPUT_MODE_THREAD).  Default stack is 1 KB, which is
# fine for trivial input handlers but not for ours: even with Qt's
# AsynchronousDelivery the call still threads through a fair bit of
# Qt-internal code (the threading detection that would route to the
# main thread is broken on this static build, so notify() ends up
# inlined).  QApplication::notify reserves ~4.5 KB of stack frame on
# entry alone -- give the input thread enough headroom for a full
# QWidget event delivery.
CONFIG_INPUT_THREAD_STACK_SIZE=32768

# Tier 3.5: PXP double-buffered DMA + hardware 90-degree rotation for
# landscape on the physically-rotated RK055.
CONFIG_DMA=y
CONFIG_MCUX_ELCDIF_PXP=y
CONFIG_MCUX_ELCDIF_PXP_ROTATE_90=y

# Larger heap than the Tier 3 demo: WidgetGallery brings in the full
# QtWidgets style machinery + multiple model/view widgets.  12 MB
# leaves headroom on top of the ~1.84 MB RGB16 framebuffer.
CONFIG_HEAP_MEM_POOL_SIZE=12582912
CONFIG_NEWLIB_LIBC_ALIGNED_HEAP_SIZE=12582912

# Widget painting recurses deeper than the Tier 3 demo (style ->
# QPainter -> FreeType).  96K is comfortable; 64K may trigger MPU
# stacking faults during initial show().
CONFIG_MAIN_STACK_SIZE=98304
```

## src/main.cpp
```c
// Tier 6: Qt official Widgets Gallery on MIMXRT1170-EVKB + RK055HDMIPI4MA0.
//
// Wraps Qt's stock examples/widgets/gallery WidgetGallery class with the
// Zephyr-side setup our QPA plugin needs: printk progress markers,
// QT_QPA_PLATFORM=zephyr forced before QApplication, and registration
// of the embedded Roboto-Regular TTF so QPainter::drawText has glyphs.

#include <QtWidgets/QApplication>
#include <QtGui/QStyleHints>
#include <QtGui/QFontDatabase>
#include <QtCore/QByteArray>

#include <zephyr/kernel.h>

#include "widgetgallery.h"

extern "C" unsigned char g_embedded_roboto_ttf[];
extern "C" unsigned int g_embedded_roboto_ttf_len;

int main(int argc, char *argv[])
{
    printk("[qt-widgets-gallery] pre-Qt main(); arg count = %d\n", argc);
    qputenv("QT_QPA_PLATFORM", QByteArray("zephyr"));

    QApplication app(argc, argv);
    printk("[qt-widgets-gallery] QApplication constructed\n");

    const QByteArray fontData(reinterpret_cast<const char *>(g_embedded_roboto_ttf),
                              int(g_embedded_roboto_ttf_len));
    const int fontId = QFontDatabase::addApplicationFontFromData(fontData);
    if (fontId >= 0) {
        const QStringList families = QFontDatabase::applicationFontFamilies(fontId);
        if (!families.isEmpty()) {
            QApplication::setFont(QFont(families.first()));
            printk("[qt-widgets-gallery] using font: %s\n",
                   families.first().toUtf8().constData());
        }
    } else {
        printk("[qt-widgets-gallery] addApplicationFontFromData failed\n");
    }

    QGuiApplication::styleHints()->setColorScheme(Qt::ColorScheme::Dark);

    WidgetGallery gallery;
    gallery.show();
    printk("[qt-widgets-gallery] WidgetGallery shown; entering exec()\n");

    const int rc = QCoreApplication::exec();
    printk("[qt-widgets-gallery] exec() returned %d\n", rc);
    return rc;
}
```

## src/plugin_import.cpp
```c
// Force the static qzephyr platform plugin's symbols out of
// libqzephyr.a and pre-set QT_QPA_PLATFORM=zephyr before QGuiApplication
// even gets constructed.

#include <QtCore/qstring.h>
#include <QtCore/qbytearray.h>
#include <QtCore/QtPlugin>
#include <cstdlib>

namespace {
__attribute__((constructor)) void zephyr_qpa_default()
{
    if (!std::getenv("QT_QPA_PLATFORM"))
        setenv("QT_QPA_PLATFORM", "zephyr", 0);
}
} // namespace

Q_IMPORT_PLUGIN(QZephyrIntegrationPlugin)
```

## src/posix_stubs.c
```c
/*
 * libc function stubs the Tier 2 picture-less smoke test needs at link
 * time but never actually calls at runtime.
 *
 * Picolibc on Cortex-M7 (the default libc on RT1170-EVKB) does not
 * provide a number of POSIX functions that Qt corelib references
 * unconditionally from its UNIX file engine / lockfile / sysinfo
 * paths.  None of these are on the QCoreApplication + QTimer dispatch
 * path that this test exercises, so weak stubs returning -1/ENOSYS
 * (or a benign zero/NULL) are enough to let ld finish.  A future Tier
 * that actually needs filesystem locking, real hostname, etc. can
 * provide strong overrides.
 *
 * All symbols are weak so picolibc/newlib can override them at link
 * time on host builds (where these exist for real).
 */

#include <errno.h>
#include <stddef.h>
#include <sys/types.h>

#define STUB_FAIL do { errno = ENOSYS; return -1; } while (0)

__attribute__((weak)) int gethostname(char *name, size_t len)         { (void)name; (void)len; STUB_FAIL; }
/* QCoreApplication ctor on Q_OS_UNIX calls getuid() to decide whether
 * the app is running as root.  Picolibc does not provide these; report
 * a benign non-root uid/gid so the path through QCoreApplicationPrivate
 * doesn't hit a wild-pointer jump. */
__attribute__((weak)) uid_t getuid(void)                              { return 1000; }
__attribute__((weak)) uid_t geteuid(void)                             { return 1000; }
__attribute__((weak)) gid_t getgid(void)                              { return 1000; }
__attribute__((weak)) gid_t getegid(void)                             { return 1000; }
__attribute__((weak)) int truncate(const char *p, off_t len)          { (void)p; (void)len; STUB_FAIL; }
__attribute__((weak)) int flock(int fd, int op)                       { (void)fd; (void)op; STUB_FAIL; }
__attribute__((weak)) int fchmod(int fd, mode_t m)                    { (void)fd; (void)m; STUB_FAIL; }
__attribute__((weak)) int chmod(const char *p, mode_t m)              { (void)p; (void)m; STUB_FAIL; }
__attribute__((weak)) int access(const char *p, int m)                { (void)p; (void)m; STUB_FAIL; }
__attribute__((weak)) int link(const char *o, const char *n)          { (void)o; (void)n; STUB_FAIL; }
__attribute__((weak)) int symlink(const char *t, const char *l)       { (void)t; (void)l; STUB_FAIL; }
__attribute__((weak)) ssize_t readlink(const char *p, char *b, size_t s) { (void)p; (void)b; (void)s; STUB_FAIL; }
__attribute__((weak)) char *realpath(const char *p, char *r)          { (void)p; (void)r; errno = ENOSYS; return NULL; }
__attribute__((weak)) char *getcwd(char *b, size_t s)                 { (void)b; (void)s; errno = ENOSYS; return NULL; }

/*
 * passwd / group entries.  Picolibc's <pwd.h> / <grp.h> may not be on
 * the include path; declare the minimal struct shape we need locally.
 */
struct passwd; struct group;
__attribute__((weak)) struct passwd *getpwuid(uid_t uid)              { (void)uid; errno = ENOSYS; return NULL; }
__attribute__((weak)) struct group  *getgrgid(gid_t gid)              { (void)gid; errno = ENOSYS; return NULL; }
```

## src/widgetgallery.cpp
```c
// Copyright (C) 2020 The Qt Company Ltd.
// SPDX-License-Identifier: LicenseRef-Qt-Commercial OR BSD-3-Clause

#include "widgetgallery.h"

#include <QApplication>
#include <QCheckBox>
#include <QComboBox>
#include <QCommandLinkButton>
#include <QDateTimeEdit>
#include <QDial>
#include <QDialogButtonBox>
#include <QFileSystemModel>
#include <QGridLayout>
#include <QGroupBox>
#include <QLabel>
#include <QLineEdit>
#include <QListWidget>
#include <QMenu>
#include <QPlainTextEdit>
#include <QProgressBar>
#include <QPushButton>
#include <QRadioButton>
#include <QScrollBar>
#include <QShortcut>
#include <QSpinBox>
#include <QStandardItemModel>
#include <QStyle>
#include <QStyleFactory>
#include <QStyleHints>
#include <QTableWidget>
#include <QTextBrowser>
#include <QTextEdit>
#include <QToolBox>
#include <QToolButton>
#include <QTreeView>

#include <QDesktopServices>
#include <QIcon>
#include <QScreen>
#include <QWindow>

#include <QAnyStringView>
#include <QDebug>
#include <QLibraryInfo>
#include <QStringView>
#include <QSysInfo>
#include <QTextStream>
#include <QTimer>

using namespace Qt::StringLiterals;

static inline QString className(const QObject *o)
{
     return QString::fromUtf8(o->metaObject()->className());
}

static inline void setClassNameToolTip(QWidget *w)
{
    w->setToolTip(className(w));
}

static QString helpUrl(QStringView page)
{
    QString result;
    QTextStream(&result) << "https://doc.qt.io/qt-" << QT_VERSION_MAJOR
        << '/' << page << ".html";
    return result;
}

static inline QString helpUrl(const QWidget *w)
{
    return helpUrl(className(w).toLower());
}

static void launchHelp(const QWidget *w)
{
     QDesktopServices::openUrl(helpUrl(w));
}

static void launchModuleHelp()
{
    QDesktopServices::openUrl(helpUrl(u"qtwidgets-index"));
}

template <class Widget>
Widget *createWidget(QAnyStringView name, QWidget *parent = nullptr)
{
    auto *result = new Widget(parent);
    result->setObjectName(name);
    setClassNameToolTip(result);
    return result;
}

template <class Widget, class Parameter>
Widget *createWidget1(const Parameter &p1, QAnyStringView name, QWidget *parent = nullptr)
{
    auto *result = new Widget(p1, parent);
    result->setObjectName(name);
    setClassNameToolTip(result);
    return result;
}

QTextStream &operator<<(QTextStream &str, const QRect &r)
{
    str << r.width() << 'x' << r.height() << Qt::forcesign << r.x() << r.y()
        << Qt::noforcesign;
    return str;
}

static QString highDpiScaleFactorRoundingPolicy()
{
    QString result;
    QDebug(&result) << QGuiApplication::highDpiScaleFactorRoundingPolicy();
    if (result.endsWith(u')'))
        result.chop(1);
    const auto lastSep = result.lastIndexOf("::"_L1);
    if (lastSep != -1)
        result.remove(0, lastSep + 2);
    return result;
}

WidgetGallery::WidgetGallery(QWidget *parent)
    : QDialog(parent)
    , progressBar(createProgressBar())
{
    setWindowFlags(windowFlags() & ~Qt::WindowContextHelpButtonHint);

    auto *styleComboBox = createWidget<QComboBox>("styleComboBox");
    const QString defaultStyleName = QApplication::style()->objectName();
    QStringList styleNames = QStyleFactory::keys();
    for (qsizetype i = 1, size = styleNames.size(); i < size; ++i) {
        if (defaultStyleName.compare(styleNames.at(i), Qt::CaseInsensitive) == 0) {
            styleNames.swapItemsAt(0, i);
            break;
        }
    }
    styleComboBox->addItems(styleNames);

    auto *styleLabel = createWidget1<QLabel>(tr("&Style:"), "styleLabel");
    styleLabel->setBuddy(styleComboBox);

    auto *colorSchemeComboBox = createWidget<QComboBox>("colorSchemeComboBox");
    colorSchemeComboBox->addItem(tr("Auto"));
    colorSchemeComboBox->addItem(tr("Light"));
    colorSchemeComboBox->addItem(tr("Dark"));
    colorSchemeComboBox->setCurrentIndex(static_cast<int>(qApp->styleHints()->colorScheme()));

    auto *colorSchemeLabel = createWidget1<QLabel>(tr("&Color Scheme:"), "colorSchemeLabel");
    colorSchemeLabel->setBuddy(colorSchemeComboBox);

    connect(colorSchemeComboBox, &QComboBox::currentIndexChanged, this, [](int index){
        QGuiApplication::styleHints()->setColorScheme(static_cast<Qt::ColorScheme>(index));
    });

    const QKeySequence helpKeySequence(QKeySequence::HelpContents);
    const QString helpText = tr("Press <kbd>%1</kbd> over a widget to see Documentation")
                                     .arg(helpKeySequence.toString(QKeySequence::NativeText));
    auto *helpLabel = createWidget1<QLabel>(helpText, "helpLabel");

    auto *disableWidgetsCheckBox = createWidget1<QCheckBox>(tr("&Disable widgets"), "disableWidgetsCheckBox");

    auto *buttonsGroupBox = createButtonsGroupBox();
    auto *itemViewTabWidget = createItemViewTabWidget();
    auto *simpleInputWidgetsGroupBox = createSimpleInputWidgetsGroupBox();
    auto *textToolBox = createTextToolBox();

    connect(styleComboBox, &QComboBox::textActivated,
            this, &WidgetGallery::changeStyle);
    connect(disableWidgetsCheckBox, &QCheckBox::toggled,
            buttonsGroupBox, &QWidget::setDisabled);
    connect(disableWidgetsCheckBox, &QCheckBox::toggled,
            textToolBox, &QWidget::setDisabled);
    connect(disableWidgetsCheckBox, &QCheckBox::toggled,
            itemViewTabWidget, &QWidget::setDisabled);
    connect(disableWidgetsCheckBox, &QCheckBox::toggled,
            simpleInputWidgetsGroupBox, &QWidget::setDisabled);

    auto *topLayout = new QHBoxLayout;
    auto *appearanceLayout = new QGridLayout;
    appearanceLayout->addWidget(styleLabel, 0, 0);
    appearanceLayout->addWidget(styleComboBox, 0, 1);
    appearanceLayout->addWidget(colorSchemeLabel, 1, 0);
    appearanceLayout->addWidget(colorSchemeComboBox, 1, 1);
    topLayout->addLayout(appearanceLayout);
    topLayout->addStretch(1);
    topLayout->addWidget(helpLabel);
    topLayout->addStretch(1);
    topLayout->addWidget(disableWidgetsCheckBox);

    auto *dialogButtonBox = createWidget1<QDialogButtonBox>(
            QDialogButtonBox::Help | QDialogButtonBox::Close, "dialogButtonBox");
    connect(dialogButtonBox, &QDialogButtonBox::helpRequested, this, launchModuleHelp);
    connect(dialogButtonBox, &QDialogButtonBox::rejected, this, &QDialog::reject);

    auto *mainLayout = new QGridLayout(this);
    mainLayout->addLayout(topLayout, 0, 0, 1, 2);
    mainLayout->addWidget(buttonsGroupBox, 1, 0);
    mainLayout->addWidget(simpleInputWidgetsGroupBox, 1, 1);
    mainLayout->addWidget(itemViewTabWidget, 2, 0);
    mainLayout->addWidget(textToolBox, 2, 1);
    mainLayout->addWidget(progressBar, 3, 0, 1, 2);
    mainLayout->addWidget(dialogButtonBox, 4, 0, 1, 2);

    setWindowTitle(tr("Widget Gallery Qt %1").arg(QT_VERSION_STR));

    new QShortcut(helpKeySequence, this, this, &WidgetGallery::helpOnCurrentWidget);
}

void  WidgetGallery::setVisible(bool visible)
{
    QDialog::setVisible(visible);
    if (visible) {
        connect(windowHandle(), &QWindow::screenChanged, this, &WidgetGallery::updateSystemInfo);
        updateSystemInfo();
    }
}

void WidgetGallery::changeStyle(const QString &styleName)
{
    QApplication::setStyle(QStyleFactory::create(styleName));
}

void WidgetGallery::advanceProgressBar()
{
    int curVal = progressBar->value();
    int maxVal = progressBar->maximum();
    progressBar->setValue(curVal + (maxVal - curVal) / 100);
}

QGroupBox *WidgetGallery::createButtonsGroupBox()
{
    auto *result = createWidget1<QGroupBox>(tr("Buttons"), "buttonsGroupBox");

    auto *defaultPushButton = createWidget1<QPushButton>(tr("Default Push Button"), "defaultPushButton");
    defaultPushButton->setDefault(true);

    auto *togglePushButton = createWidget1<QPushButton>(tr("Toggle Push Button"), "togglePushButton");
    togglePushButton->setCheckable(true);
    togglePushButton->setChecked(true);

    auto *flatPushButton = createWidget1<QPushButton>(tr("Flat Push Button"), "flatPushButton");
    flatPushButton->setFlat(true);

    auto *toolButton = createWidget<QToolButton>("toolButton");
    toolButton->setText(tr("Tool Button"));

    auto *menuToolButton = createWidget<QToolButton>("menuButton");
    menuToolButton->setText(tr("Menu Button"));
    auto *toolMenu = new QMenu(menuToolButton);
    menuToolButton->setPopupMode(QToolButton::InstantPopup);
    toolMenu->addAction("Option");
    toolMenu->addSeparator();
    auto *action = toolMenu->addAction("Checkable Option");
    action->setCheckable(true);
    menuToolButton->setMenu(toolMenu);
    auto *toolLayout = new QHBoxLayout;
    toolLayout->addWidget(toolButton);
    toolLayout->addWidget(menuToolButton);

    auto *commandLinkButton = createWidget1<QCommandLinkButton>(tr("Command Link Button"), "commandLinkButton");
    commandLinkButton->setDescription(tr("Description"));

    auto *buttonLayout = new QVBoxLayout;
    buttonLayout->addWidget(defaultPushButton);
    buttonLayout->addWidget(togglePushButton);
    buttonLayout->addWidget(flatPushButton);
    buttonLayout->addLayout(toolLayout);
    buttonLayout->addWidget(commandLinkButton);
    buttonLayout->addStretch(1);

    auto *radioButton1 = createWidget1<QRadioButton>(tr("Radio button 1"), "radioButton1");
    auto *radioButton2 = createWidget1<QRadioButton>(tr("Radio button 2"), "radioButton2");
    auto *radioButton3 = createWidget1<QRadioButton>(tr("Radio button 3"), "radioButton3");
    radioButton1->setChecked(true);

    auto *checkBox =  createWidget1<QCheckBox>(tr("Tri-state check box"), "checkBox");
    checkBox->setTristate(true);
    checkBox->setCheckState(Qt::PartiallyChecked);

    auto *checkableLayout = new QVBoxLayout;
    checkableLayout->addWidget(radioButton1);
    checkableLayout->addWidget(radioButton2);
    checkableLayout->addWidget(radioButton3);
    checkableLayout->addWidget(checkBox);
    checkableLayout->addStretch(1);

    auto *mainLayout = new QHBoxLayout(result);
    mainLayout->addLayout(buttonLayout);
    mainLayout->addLayout(checkableLayout);
    mainLayout->addStretch();
    return result;
}

static QWidget *embedIntoHBoxLayout(QWidget *w, int margin = 5)
{
    auto *result = new QWidget;
    auto *layout = new QHBoxLayout(result);
    layout->setContentsMargins(margin, margin, margin, margin);
    layout->addWidget(w);
    return result;
}

QToolBox *WidgetGallery::createTextToolBox()
{
    auto *result = createWidget<QToolBox>("toolBox");

    const QString plainText = tr("Twinkle, twinkle, little star,\n"
                            "How I wonder what you are.\n"
                            "Up above the world so high,\n"
                            "Like a diamond in the sky.\n"
                            "Twinkle, twinkle, little star,\n"
                            "How I wonder what you are!\n");
    // Create centered/italic HTML rich text
    QString richText = "<html><head/><body><i>"_L1;
    for (const auto &line : QStringView{ plainText }.split(u'\n'))
        richText += "<center>"_L1 + line + "</center>"_L1;
    richText += "</i></body></html>"_L1;

    auto *textEdit = createWidget1<QTextEdit>(richText, "textEdit");
    auto *plainTextEdit = createWidget1<QPlainTextEdit>(plainText, "plainTextEdit");

    systemInfoTextBrowser = createWidget<QTextBrowser>("systemInfoTextBrowser");

    result->addItem(embedIntoHBoxLayout(textEdit), tr("Text Edit"));
    result->addItem(embedIntoHBoxLayout(plainTextEdit), tr("Plain Text Edit"));
    result->addItem(embedIntoHBoxLayout(systemInfoTextBrowser), tr("Text Browser"));
    return result;
}

QTabWidget *WidgetGallery::createItemViewTabWidget()
{
    auto *result = createWidget<QTabWidget>("bottomLeftTabWidget");
    result->setSizePolicy(QSizePolicy::Preferred, QSizePolicy::Ignored);

    auto *treeView = createWidget<QTreeView>("treeView");
    auto *fileSystemModel = new QFileSystemModel(treeView);
    fileSystemModel->setRootPath(QDir::rootPath());
    treeView->setModel(fileSystemModel);

    auto *tableWidget = createWidget<QTableWidget>("tableWidget");
    tableWidget->setRowCount(10);
    tableWidget->setColumnCount(10);

    auto *listModel = new QStandardItemModel(0, 1, result);
    listModel->appendRow(new QStandardItem(QIcon(":/qt-project.org/styles/commonstyle/images/diropen-128.png"_L1),
                                           tr("Directory")));
    listModel->appendRow(new QStandardItem(QIcon(":/qt-project.org/styles/commonstyle/images/computer-32.png"_L1),
                                           tr("Computer")));

    auto *listView = createWidget<QListView>("listView");
    listView->setModel(listModel);

    auto *iconModeListView = createWidget<QListView>("iconModeListView");
    iconModeListView->setViewMode(QListView::IconMode);
    iconModeListView->setModel(listModel);

    result->addTab(embedIntoHBoxLayout(treeView), tr("&Tree View"));
    result->addTab(embedIntoHBoxLayout(tableWidget), tr("T&able"));
    result->addTab(embedIntoHBoxLayout(listView), tr("&List"));
    result->addTab(embedIntoHBoxLayout(iconModeListView), tr("&Icon Mode List"));
    return result;
}

QGroupBox *WidgetGallery::createSimpleInputWidgetsGroupBox()
{
    auto *result = createWidget1<QGroupBox>(tr("Simple Input Widgets"), "bottomRightGroupBox");
    result->setCheckable(true);
    result->setChecked(true);

    auto *lineEdit = createWidget1<QLineEdit>("s3cRe7", "lineEdit");
    lineEdit->setClearButtonEnabled(true);
    lineEdit->setEchoMode(QLineEdit::Password);

    auto *spinBox = createWidget<QSpinBox>("spinBox", result);
    spinBox->setValue(50);

    auto *dateTimeEdit = createWidget<QDateTimeEdit>("dateTimeEdit", result);
    dateTimeEdit->setDateTime(QDateTime::currentDateTime());

    auto *slider = createWidget<QSlider>("slider", result);
    slider->setOrientation(Qt::Horizontal);
    slider->setValue(40);

    auto *scrollBar = createWidget<QScrollBar>("scrollBar", result);
    scrollBar->setOrientation(Qt::Horizontal);
    setClassNameToolTip(scrollBar);
    scrollBar->setValue(60);

    auto *dial = createWidget<QDial>("dial", result);
    dial->setValue(30);
    dial->setNotchesVisible(true);

    auto *layout = new QGridLayout(result);
    layout->addWidget(lineEdit, 0, 0, 1, 2);
    layout->addWidget(spinBox, 1, 0, 1, 2);
    layout->addWidget(dateTimeEdit, 2, 0, 1, 2);
    layout->addWidget(slider, 3, 0);
    layout->addWidget(scrollBar, 4, 0);
    layout->addWidget(dial, 3, 1, 2, 1);
    layout->setRowStretch(5, 1);
    return result;
}

QProgressBar *WidgetGallery::createProgressBar()
{
    auto *result = createWidget<QProgressBar>("progressBar");
    result->setRange(0, 10000);
    result->setValue(0);

    auto *timer = new QTimer(this);
    connect(timer, &QTimer::timeout, this, &WidgetGallery::advanceProgressBar);
    timer->start(1000);
    return result;
}

void WidgetGallery::updateSystemInfo()
{
    QString systemInfo;
    QTextStream str(&systemInfo);
    str << "<html><head/><body><h3>Build</h3><p>" << QLibraryInfo::build() << "</p>"
        << "<h3>Operating System</h3><p>\"" << QSysInfo::prettyProductName() << "\" / "
        << QGuiApplication::platformName() << "</p>"
        << "<h3>Screens</h3><p>High DPI scale factor rounding policy: "
        << highDpiScaleFactorRoundingPolicy() << "</p><ol>";
    const auto screens = QGuiApplication::screens();
    for (const auto *screen : screens) {
        const bool current = screen == this->screen();
        str << "<li>";
        if (current)
            str << "<i>";
        str << '"' << screen->name() << "\" " << screen->geometry() << ", "
            << screen->logicalDotsPerInchX() << "DPI, DPR="
            << screen->devicePixelRatio();
        if (current)
            str << "</i>";
        str << "</li>";
    }
    str << "</ol></body></html>";
    systemInfoTextBrowser->setHtml(systemInfo);
}

void WidgetGallery::helpOnCurrentWidget()
{
    // Skip over internal widgets
    for (const auto *w = QApplication::widgetAt(QCursor::pos(screen())); w; w = w->parentWidget()) {
        const QString name = w->objectName();
        if (!name.isEmpty() && !name.startsWith("qt_"_L1)) {
            launchHelp(w);
            break;
        }
    }
}
```

## src/widgetgallery.h
```c
// Copyright (C) 2020 The Qt Company Ltd.
// SPDX-License-Identifier: LicenseRef-Qt-Commercial OR BSD-3-Clause

#ifndef WIDGETGALLERY_H
#define WIDGETGALLERY_H

#include <QDialog>

QT_BEGIN_NAMESPACE
class QGroupBox;
class QProgressBar;
class QTabWidget;
class QTextBrowser;
class QToolBox;
QT_END_NAMESPACE

class WidgetGallery : public QDialog
{
    Q_OBJECT

public:
    explicit WidgetGallery(QWidget *parent = nullptr);

    void setVisible(bool visible) override;

private slots:
    void changeStyle(const QString &styleName);
    void advanceProgressBar();
    void helpOnCurrentWidget();
    void updateSystemInfo();

private:
    static QGroupBox *createButtonsGroupBox();
    static QTabWidget *createItemViewTabWidget();
    static QGroupBox *createSimpleInputWidgetsGroupBox();
    QToolBox *createTextToolBox();
    QProgressBar *createProgressBar();

    QProgressBar *progressBar;
    QTextBrowser *systemInfoTextBrowser{};
};

#endif // WIDGETGALLERY_H
```
