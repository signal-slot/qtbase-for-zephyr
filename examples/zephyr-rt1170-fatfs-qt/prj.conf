## CMakeLists.txt
```
# Qt + FAT filesystem on SD card test for RT1170-EVKB
#
# Build:
#   west build -b mimxrt1170_evk@B/mimxrt1176/cm7 -p always \
#       qt5/qtbase/examples/zephyr-rt1170-fatfs-qt -- -DSHIELD=rk055hdmipi4ma0

cmake_minimum_required(VERSION 3.20.0)

set(CMAKE_CXX_LINK_LIBRARY_USING_WHOLE_ARCHIVE
    "LINKER:--push-state,--whole-archive"
    "<LINK_ITEM>"
    "LINKER:--pop-state")
set(CMAKE_CXX_LINK_LIBRARY_USING_WHOLE_ARCHIVE_SUPPORTED TRUE)

find_package(Zephyr REQUIRED HINTS $ENV{ZEPHYR_BASE})
project(fatfs_qt LANGUAGES CXX C)

set(CMAKE_CXX_COMPILE_FEATURES cxx_std_17 CACHE STRING "" FORCE)

list(APPEND CMAKE_PREFIX_PATH "$ENV{QT_ZEPHYR_PREFIX}")
find_package(Qt6 REQUIRED COMPONENTS Core Gui Widgets)

target_sources(app PRIVATE src/main.cpp)
target_link_libraries(app PRIVATE
    Qt6::Widgets
    Qt6::Gui
    Qt6::Core
)
```

## prj.conf
```kconfig
# Qt + FAT filesystem on SD card

CONFIG_QT=y
CONFIG_QT_GUI=y
CONFIG_QT_WIDGETS=y
CONFIG_QT_EMBEDDED_ROBOTO_FONT=y

CONFIG_DISPLAY=y
CONFIG_INPUT=y

CONFIG_DISK_ACCESS=y
CONFIG_DISK_DRIVER_SDMMC=y
CONFIG_FILE_SYSTEM=y
CONFIG_FAT_FILESYSTEM_ELM=y
CONFIG_FS_FATFS_LFN=y
CONFIG_FS_FATFS_MAX_LFN=255

CONFIG_MAIN_STACK_SIZE=524288
CONFIG_ISR_STACK_SIZE=8192
CONFIG_IDLE_STACK_SIZE=4096
CONFIG_HEAP_MEM_POOL_SIZE=16777216

CONFIG_CONSOLE=y
CONFIG_UART_CONSOLE=y
CONFIG_PRINTK=y
CONFIG_STDOUT_CONSOLE=y
CONFIG_DMA=y
CONFIG_MCUX_ELCDIF_PXP=y
CONFIG_MCUX_ELCDIF_PXP_ROTATE_90=y

CONFIG_NEWLIB_LIBC=y
CONFIG_POSIX_API=y

CONFIG_FPU=y

CONFIG_CPP=y
CONFIG_STD_CPP17=y
CONFIG_CPP_EXCEPTIONS=y
CONFIG_GLIBCXX_LIBCPP=y
CONFIG_CPP_RTTI=y
```

## src/main.cpp
```c
#include <zephyr/kernel.h>
#include <zephyr/storage/disk_access.h>
#include <zephyr/fs/fs.h>
#include <ff.h>

#include <QApplication>
#include <QLabel>
#include <QFile>
#include <QDir>
#include <QTextStream>

static FATFS fat_fs;
static struct fs_mount_t mp = {
    .type = FS_FATFS,
    .fs_data = &fat_fs,
};

static bool mount_sd()
{
    if (disk_access_init("SD") != 0) {
        printk("[qt-fatfs] disk_access_init failed\n");
        return false;
    }
    mp.mnt_point = "/SD:";
    if (fs_mount(&mp) != 0) {
        printk("[qt-fatfs] mount failed\n");
        return false;
    }
    printk("[qt-fatfs] SD card mounted at /SD:\n");
    return true;
}

int main(int /*argc_zephyr*/, char * /*argv_zephyr*/[])
{
    printk("\n[qt-fatfs] === Qt + FAT filesystem test ===\n");

    bool sd_ok = mount_sd();

    static char arg0[] = "qt-fatfs";
    static char *argv[] = { arg0, nullptr };
    int argc = 1;
    qputenv("QT_QPA_PLATFORM", "zephyr");

    QApplication app(argc, argv);

    QString result;
    if (!sd_ok) {
        result = "SD card not available.\nInsert a FAT32 SD card and reset.";
    } else {
        QString path = "/SD:/qt_test.txt";

        QFile wf(path);
        if (wf.open(QIODevice::WriteOnly | QIODevice::Text)) {
            QTextStream out(&wf);
            out << "Hello from Qt 6 on Zephyr!\n";
            out << "QFile write test OK.\n";
            wf.close();
            result += "Wrote: " + path + "\n\n";
            printk("[qt-fatfs] QFile write OK\n");
        } else {
            result += "Write failed: " + wf.errorString() + "\n";
            printk("[qt-fatfs] QFile write failed\n");
        }

        QFile rf(path);
        if (rf.open(QIODevice::ReadOnly | QIODevice::Text)) {
            QString content = rf.readAll();
            rf.close();
            result += "Read back:\n" + content;
            printk("[qt-fatfs] QFile read OK\n");
        } else {
            result += "Read failed: " + rf.errorString() + "\n";
            printk("[qt-fatfs] QFile read failed\n");
        }
    }

    printk("[qt-fatfs] result: %s\n", result.toUtf8().constData());

    QLabel label;
    label.setText(result);
    label.setStyleSheet("QLabel { font-size: 28px; padding: 40px; }");
    label.setAlignment(Qt::AlignLeft | Qt::AlignTop);
    label.showFullScreen();

    return app.exec();
}
```
