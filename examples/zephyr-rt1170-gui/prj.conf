## CMakeLists.txt
```
# Tier 3 example -- QGuiApplication + qzephyr QPA plugin driving the
# RK055HDMIPI4MA0 panel on MIMXRT1170-EVKB via Zephyr's display API.
#
# Usage:
#   export ZEPHYR_BASE=~/org/zephyrproject/zephyrproject/zephyr
#   export QT_ZEPHYR_PREFIX=~/qt-zephyr-rt1170
#   export QT_ZEPHYR_SOURCE=$PWD/../../qt5/qtbase
#   west build -b mimxrt1170_evk@B/mimxrt1176/cm7 -p always \
#     examples/zephyr-rt1170-gui -- -DSHIELD=rk055hdmipi4ma0
#   west flash --runner linkserver
#   # press SW4 to reboot from QSPI

cmake_minimum_required(VERSION 3.20.0)
find_package(Zephyr REQUIRED HINTS $ENV{ZEPHYR_BASE})
project(qt_zephyr_rt1170_gui LANGUAGES CXX C)

set(CMAKE_PREFIX_PATH "$ENV{QT_ZEPHYR_PREFIX}" ${CMAKE_PREFIX_PATH})

# This example now lives inside qtbase; the source root is two levels up.
set(QT_QTBASE_SOURCE "${CMAKE_CURRENT_SOURCE_DIR}/../..")

find_package(Qt6 REQUIRED COMPONENTS Core Gui)

set_property(TARGET Qt6::Core PROPERTY INTERFACE_COMPILE_FEATURES "")
set_property(TARGET Qt6::Gui  PROPERTY INTERFACE_COMPILE_FEATURES "")

# Stage 1 cross-built Qt with -fno-short-enums so QCborValue::Type and
# QJsonValue::Type both stay 4-byte (the static_assert in
# qjsonvalue.h:138 trips otherwise).  ARM EABI default is -fshort-enums,
# which Zephyr inherits.  Force the app TUs to match Stage 1's ABI.
zephyr_compile_options(-fno-short-enums)

# QEventDispatcherZephyr has Q_OBJECT -- moc must run.
set_target_properties(app PROPERTIES AUTOMOC ON)

target_sources(app PRIVATE
    src/main.cpp

    # libc / Qt-internal stubs shared with the picture-less example.
    src/posix_stubs.c
    src/qt_zephyr_stubs.cpp

    # Embedded TTF (Roboto-Regular, 350KB) generated by `xxd -i`.
    # main.cpp registers it via QFontDatabase::addApplicationFontFromData.
    src/embedded_font.c

    # Force the qzephyr plugin's QZephyrIntegrationPlugin symbols out
    # of libqzephyr.a into the final ELF, and pre-set
    # QT_QPA_PLATFORM=zephyr before main().
    src/plugin_import.cpp

    # Tier 3-2/3-3 strong impls of the weak qzephyr_* hooks declared
    # in qzephyrbackingstore.cpp / qzephyrscreen.cpp.  Pulls in
    # <zephyr/drivers/display.h>.
    src/qzephyr_display_zephyr.cpp

    # Tier 4: GT911 capacitive touch -> QWindowSystemInterface mouse
    # events.  INPUT_CALLBACK_DEFINE-registered callback that runs in
    # Zephyr's input thread context.
    src/qzephyr_touch_zephyr.cpp

    # Stage-1 deferred Zephyr-runtime event dispatcher.
    "${QT_QTBASE_SOURCE}/src/corelib/kernel/qeventdispatcher_zephyr.cpp"
)

file(GLOB QT_PRIVATE_VERSION_DIR
    LIST_DIRECTORIES TRUE
    "$ENV{QT_ZEPHYR_PREFIX}/include/QtCore/[0-9]*.[0-9]*.[0-9]*")
list(GET QT_PRIVATE_VERSION_DIR 0 QT_PRIVATE_VERSION_DIR)

target_include_directories(app PRIVATE
    "$ENV{QT_ZEPHYR_PREFIX}/include"
    "$ENV{QT_ZEPHYR_PREFIX}/include/QtCore"
    "$ENV{QT_ZEPHYR_PREFIX}/include/QtGui"
    "${QT_PRIVATE_VERSION_DIR}"
    "${QT_PRIVATE_VERSION_DIR}/QtCore"
    # qpa/* private headers needed by the touch hook
    # (qwindowsysteminterface.h, qplatformwindow.h, etc.).
    "$ENV{QT_ZEPHYR_PREFIX}/include/QtGui/6.11.0/QtGui"
)

# Link the qzephyr platform plugin static archive ahead of Qt6::Gui so
# its strong symbols (QZephyrIntegrationPlugin etc.) get pulled in.
target_link_libraries(app PRIVATE
    "$ENV{QT_ZEPHYR_PREFIX}/plugins/platforms/libqzephyr.a"
    Qt6::Gui
    Qt6::Core
)

zephyr_link_libraries(
    "-Wl,--unresolved-symbols=ignore-all"
    "-Wl,--warn-unresolved-symbols"
)
```

## prj.conf
```kconfig
# Tier 3 GUI prj.conf -- adds display + input subsystems on top of the
# picture-less Tier 2 baseline.

# C++ baseline (matches Tier 2).
CONFIG_CPP=y
CONFIG_STD_CPP17=y
CONFIG_CPP_EXCEPTIONS=y
CONFIG_GLIBCXX_LIBCPP=y
CONFIG_CPP_RTTI=y

# Force newlib for ABI parity with Stage 1.
CONFIG_PICOLIBC=n
CONFIG_NEWLIB_LIBC=y

CONFIG_POSIX_API=y

# Hard-float -- Stage 1 was built with -mfpu=fpv5-d16 -mfloat-abi=hard.
CONFIG_FPU=y

# Console.
CONFIG_CONSOLE=y
CONFIG_UART_CONSOLE=y
CONFIG_PRINTK=y
CONFIG_STDOUT_CONSOLE=y

# Display subsystem (RK055HDMIPI4MA0 shield activated via
# -DSHIELD=rk055hdmipi4ma0 on the west build line).
CONFIG_DISPLAY=y

# Input subsystem -- needed by the shield's GT911 touch driver (Tier 4
# will hook it into QWindowSystemInterface).
CONFIG_INPUT=y

# Tier 3.5: PXP (Pixel Processing Pipeline) double-buffered DMA path.
# Without this, display_write() pushes pixels straight into the LCDIF
# scan-out framebuffer while the panel is reading from it -> visible
# tearing.  With PXP enabled the LCDIF driver internally double-buffers
# and swaps on vsync, which is what Slint's printerdemo relies on.
# Forces full-frame writes (partial updates are not supported in this
# mode); qzephyr_display_write() already always sends the bounding rect
# of the dirty region so this works out.
CONFIG_DMA=y
CONFIG_MCUX_ELCDIF_PXP=y
# Hardware rotation done during the PXP DMA so we get landscape on the
# physically-mounted-rotated RK055 without any Qt-side transform.
CONFIG_MCUX_ELCDIF_PXP_ROTATE_90=y

# Bigger heap + main stack for QtGui paint paths.  720x1280 RGB16 frame
# buffer alone is ~1.84 MB.
CONFIG_HEAP_MEM_POOL_SIZE=8388608
CONFIG_NEWLIB_LIBC_ALIGNED_HEAP_SIZE=8388608
# QPainter::drawText with FreeType pushes a lot of stack; 32K caused
# an MPU "Stacking error" fault in this app.  64K is comfortable.
CONFIG_MAIN_STACK_SIZE=65536
```

## src/main.cpp
```c
// Tier 3 GUI smoke test on MIMXRT1170-EVKB + RK055HDMIPI4MA0.
// Animates a rotating rounded rect through the qzephyr QPA plugin which
// flushes pixels via Zephyr's display_write() (see qzephyr_display_zephyr.cpp).

#include <QtGui/QGuiApplication>
#include <QtGui/QWindow>
#include <QtGui/QBackingStore>
#include <QtGui/QPainter>
#include <QtGui/QMouseEvent>
#include <QtGui/QFontDatabase>
#include <QtCore/QTimer>
#include <QtCore/QByteArray>
#include <QtGui/QScreen>

extern "C" unsigned char g_embedded_roboto_ttf[];
extern "C" unsigned int g_embedded_roboto_ttf_len;

#include <zephyr/kernel.h>

class RasterWindow : public QWindow
{
public:
    RasterWindow()
    {
        setTitle("Qt6 on RT1170 (Tier 3)");
        if (QScreen *s = QGuiApplication::primaryScreen())
            resize(s->geometry().size());
        else
            resize(720, 1280);

        m_backingStore.reset(new QBackingStore(this));

        QTimer *t = new QTimer(this);
        QObject::connect(t, &QTimer::timeout, this, [this]() {
            m_angle += 4.0;
            ++m_frame;
            if (m_frame % 60 == 0)
                printk("[qt-gui] frame=%lu angle=%.0f\n",
                       (unsigned long)m_frame, m_angle);
            renderNow();
        });
        t->start(16);
        show();
    }

protected:
    bool event(QEvent *e) override
    {
        switch (e->type()) {
        case QEvent::UpdateRequest:
            renderNow();
            return true;
        case QEvent::MouseButtonPress: {
            auto *me = static_cast<QMouseEvent *>(e);
            m_pressed = true;
            m_lastTouch = me->pos();
            printk("[qt-gui] touch press at (%d, %d)\n", me->pos().x(), me->pos().y());
            return true;
        }
        case QEvent::MouseButtonRelease: {
            auto *me = static_cast<QMouseEvent *>(e);
            m_pressed = false;
            printk("[qt-gui] touch release at (%d, %d)\n", me->pos().x(), me->pos().y());
            return true;
        }
        case QEvent::MouseMove: {
            auto *me = static_cast<QMouseEvent *>(e);
            m_lastTouch = me->pos();
            return true;
        }
        default:
            return QWindow::event(e);
        }
    }

    void exposeEvent(QExposeEvent *) override
    {
        if (isExposed())
            renderNow();
    }

private:
    void renderNow()
    {
        // QZephyrWindow currently never delivers a proper expose event so
        // isExposed() stays false even when the panel is visible.  Skip
        // the guard for now; tracked as a Tier 3.5 polish task.
        if (m_backingStore->size() != size())
            m_backingStore->resize(size());

        QRegion r(QRect(QPoint(0, 0), size()));
        m_backingStore->beginPaint(r);
        QPaintDevice *dev = m_backingStore->paintDevice();
        QPainter p(dev);
        p.fillRect(0, 0, width(), height(), QColor(30, 30, 60));
        p.setRenderHint(QPainter::Antialiasing);
        p.translate(width() / 2, height() / 2);
        p.rotate(m_angle);
        p.setBrush(m_pressed ? QColor(255, 100, 0) : QColor(0, 170, 255));
        p.setPen(Qt::NoPen);
        const int s = qMin(width(), height()) / 3;
        p.drawRoundedRect(QRect(-s, -s, 2 * s, 2 * s), 20, 20);

        // Text -- Qt6 + FreeType on Cortex-M7 demo.  Painted in screen
        // coordinates (resetTransform clears the rotate above).
        p.resetTransform();
        p.setPen(Qt::white);
        QFont f = p.font();
        f.setPixelSize(48);
        f.setBold(true);
        p.setFont(f);
        p.drawText(QRect(0, 40, width(), 80), Qt::AlignHCenter,
                   QStringLiteral("Qt 6.11 on Zephyr / RT1170"));
        f.setPixelSize(24);
        f.setBold(false);
        p.setFont(f);
        p.drawText(QRect(0, height() - 80, width(), 40), Qt::AlignHCenter,
                   QString::fromLatin1("frame %1   angle %2°")
                       .arg(m_frame).arg(int(m_angle) % 360));

        if (m_pressed || !m_lastTouch.isNull()) {
            p.setBrush(QColor(255, 255, 0));
            p.setPen(Qt::NoPen);
            p.drawEllipse(m_lastTouch, 20, 20);
        }
        p.end();
        m_backingStore->endPaint();
        m_backingStore->flush(r);
    }

    std::unique_ptr<QBackingStore> m_backingStore;
    qreal m_angle = 0;
    unsigned long m_frame = 0;
    bool m_pressed = false;
    QPoint m_lastTouch;
};

int main(int argc, char **argv)
{
    printk("[qt-gui] pre-Qt main(); arg count = %d\n", argc);
    qputenv("QT_QPA_PLATFORM", QByteArray("zephyr"));

    QGuiApplication app(argc, argv);
    printk("[qt-gui] QGuiApplication constructed\n");

    // Register the embedded Roboto so QPainter::drawText has glyphs.
    // Without this, FreeType FontDatabase returns no font and drawText
    // renders tofu boxes.
    const QByteArray fontData(reinterpret_cast<const char *>(g_embedded_roboto_ttf),
                              int(g_embedded_roboto_ttf_len));
    const int fontId = QFontDatabase::addApplicationFontFromData(fontData);
    printk("[qt-gui] addApplicationFontFromData -> id=%d (-1 means failed)\n", fontId);
    if (fontId >= 0) {
        const QStringList families = QFontDatabase::applicationFontFamilies(fontId);
        if (!families.isEmpty())
            QGuiApplication::setFont(QFont(families.first()));
    }

    RasterWindow w;
    printk("[qt-gui] RasterWindow shown; entering exec()\n");

    const int rc = app.exec();
    printk("[qt-gui] app.exec() returned %d\n", rc);
    return rc;
}
```

## src/qt_zephyr_stubs.cpp
```c
// Qt-internal symbol stubs for the Tier 2 smoke test on RT1170-EVKB.
//
// libQt6Core.a was built without these UNIX-specific translation units:
//   qstandardpaths_unix.cpp - QStandardPaths::writableLocation / standardLocations
//
// Their symbols are still referenced from portable Qt code that DOES
// live inside libQt6Core.a (qsettings.cpp uses QStandardPaths), so we
// must provide a definition or the linker either fails or -- with
// --unresolved-symbols=ignore-all -- silently binds the call sites to
// FCB junk and the firmware faults the moment any of them is touched.
//
// These stubs return "no result" semantics.  Calling them at runtime is
// harmless; the Tier 2 picture-less smoke test never reaches them.

#include <QtCore/QString>
#include <QtCore/QStringList>
#include <QtCore/QStandardPaths>

QT_BEGIN_NAMESPACE

QString QStandardPaths::writableLocation(QStandardPaths::StandardLocation)
{
    return QString();
}

QStringList QStandardPaths::standardLocations(QStandardPaths::StandardLocation)
{
    return QStringList();
}

QT_END_NAMESPACE
```

## src/qzephyr_display_zephyr.cpp
```c
// Stage 2 strong definitions of the weak qzephyr_display_* hooks that
// qzephyrbackingstore.cpp / qzephyrscreen.cpp call.  Lives in the Zephyr
// app build so it can include <zephyr/drivers/display.h>.
//
// Tier 3-2 / 3-3 design notes:
//   - qzephyr_display_query_caps() runs once during QZephyrScreen ctor
//     (inside QGuiApplication construction).  Opens the chosen display
//     device, reads caps, optionally forces RGB565 if needed, and
//     turns the backlight on.
//   - qzephyr_display_write() runs every QBackingStore::flush().
//     Reuses one static display_buffer_descriptor sized to the dirty
//     rect; QImage's scanlines go to the LCDIF driver verbatim.
//
// RK055HDMIPI4MA0 quirk: the panel driver reports BGR_565 capability
// but expects little-endian RGB565 bytes (see Zephyr issue #53642).
// Treat both BGR_565 and RGB_565 as QImage::Format_RGB16 without
// byte-swap; Slint's printerdemo does the same.

#include <zephyr/kernel.h>
#include <zephyr/drivers/display.h>
#include <zephyr/logging/log.h>

// Pull in the Zephyr-runtime event dispatcher class so we can `new` it
// in qzephyr_make_event_dispatcher() below.
#include "../../../src/corelib/kernel/qeventdispatcher_zephyr_p.h"

LOG_MODULE_REGISTER(qzephyr_display, LOG_LEVEL_INF);

// QImage::Format enum values we need to surface to Stage 1.  Hardcoded
// to match QtGui's qimage.h on Qt 6.11; sync if Qt renumbers them.
enum QtImageFormat {
    QtFmt_Invalid = 0,
    QtFmt_RGB32 = 4,                  // 0xff RR GG BB
    QtFmt_ARGB32 = 5,
    QtFmt_ARGB32_Premultiplied = 6,
    QtFmt_RGB16 = 7,                  // 565
    QtFmt_RGB888 = 13,
};

static const struct device *s_display = nullptr;
static struct display_capabilities s_caps;
static struct display_buffer_descriptor s_desc;
static bool s_display_ready = false;

extern "C" bool qzephyr_display_query_caps(int *out_w, int *out_h, int *out_qfmt)
{
    if (!s_display) {
        s_display = DEVICE_DT_GET(DT_CHOSEN(zephyr_display));
    }
    if (!device_is_ready(s_display)) {
        LOG_ERR("zephyr,display chosen device is not ready");
        return false;
    }

    display_get_capabilities(s_display, &s_caps);
    LOG_INF("display %ux%u, format=%u supported=%#x",
            s_caps.x_resolution, s_caps.y_resolution,
            s_caps.current_pixel_format, s_caps.supported_pixel_formats);

    enum display_pixel_format active = s_caps.current_pixel_format;
    if (active != PIXEL_FORMAT_RGB_565 && active != PIXEL_FORMAT_RGB_565X) {
        if (s_caps.supported_pixel_formats & PIXEL_FORMAT_RGB_565) {
            if (display_set_pixel_format(s_display, PIXEL_FORMAT_RGB_565) == 0) {
                active = PIXEL_FORMAT_RGB_565;
                LOG_INF("switched display to PIXEL_FORMAT_RGB_565");
            }
        }
    }

    int qfmt;
    switch (active) {
    case PIXEL_FORMAT_RGB_565:
    case PIXEL_FORMAT_RGB_565X:   // RK055 / byte-swapped 565 -- treat as 565 LE
        qfmt = QtFmt_RGB16;
        break;
    case PIXEL_FORMAT_RGB_888:
        qfmt = QtFmt_RGB888;
        break;
    case PIXEL_FORMAT_ARGB_8888:
        qfmt = QtFmt_ARGB32_Premultiplied;
        break;
    default:
        LOG_WRN("unsupported pixel format %u, defaulting to RGB16", active);
        qfmt = QtFmt_RGB16;
        break;
    }

    // With CONFIG_MCUX_ELCDIF_PXP_ROTATE_90 / _270 the driver still
    // reports panelWidth x panelHeight (720 x 1280) in caps, but PXP
    // rotates the source 90/270 degrees during DMA -- so the source
    // buffer Qt should produce is 1280 x 720.  Same idea for 180 (no
    // swap needed, dimensions identical) and the no-rotation case.
#if defined(CONFIG_MCUX_ELCDIF_PXP_ROTATE_90) || defined(CONFIG_MCUX_ELCDIF_PXP_ROTATE_270)
    *out_w = s_caps.y_resolution;
    *out_h = s_caps.x_resolution;
#else
    *out_w = s_caps.x_resolution;
    *out_h = s_caps.y_resolution;
#endif
    *out_qfmt = qfmt;
    s_display_ready = true;

    display_blanking_off(s_display);
    return true;
}

// Strong def of the weak hook in qzephyrintegration.cpp.  Called once
// during QPlatformIntegration::createEventDispatcher() while
// QGuiApplication is being constructed.  We hand it a freshly-allocated
// QEventDispatcherZephyr; QPlatformIntegration takes ownership.
extern "C" QAbstractEventDispatcher *qzephyr_make_event_dispatcher()
{
    return new QEventDispatcherZephyr();
}

extern "C" void qzephyr_display_write(int x, int y, int w, int h,
                                       int pitch_bytes, int bytes_per_pixel,
                                       const void *buf)
{
    static uint32_t call_count = 0;
    ++call_count;

    if (!s_display_ready) {
        if (call_count <= 3)
            printk("[qzephyr_display_write] s_display_ready=false (call %u)\n", call_count);
        return;
    }
    if (w <= 0 || h <= 0) {
        if (call_count <= 3)
            printk("[qzephyr_display_write] empty rect %dx%d (call %u)\n", w, h, call_count);
        return;
    }

    s_desc.buf_size = static_cast<uint32_t>(h * pitch_bytes);
    s_desc.width = static_cast<uint16_t>(w);
    s_desc.height = static_cast<uint16_t>(h);
    // Zephyr's `pitch` field is in PIXELS, not bytes.
    s_desc.pitch = static_cast<uint16_t>(pitch_bytes / bytes_per_pixel);
    s_desc.frame_incomplete = false;

    const int ret = display_write(s_display,
                                  static_cast<uint16_t>(x),
                                  static_cast<uint16_t>(y),
                                  &s_desc, buf);
    if (ret != 0)
        LOG_WRN("display_write(%d,%d %dx%d) failed: %d", x, y, w, h, ret);
}
```

## src/qzephyr_touch_zephyr.cpp
```c
// Tier 4: GT911 capacitive touch -> QWindowSystemInterface mouse events.
//
// Zephyr's input subsystem delivers raw input_event structs from the
// GT911 driver via INPUT_CALLBACK_DEFINE.  We accumulate X/Y absolute
// coordinates and the BTN_TOUCH press/release flag across events, then
// when `sync` is set we post a synthesized QMouseEvent through
// QWindowSystemInterface so QGuiApplication can dispatch it.
//
// Pattern mirrors Slint's printerdemo touch handling.

#include <zephyr/kernel.h>
#include <zephyr/device.h>
#include <zephyr/input/input.h>
#include <zephyr/dt-bindings/input/input-event-codes.h>
#include <zephyr/logging/log.h>

#include <QtCore/QPoint>
#include <QtCore/Qt>
#include <QtGui/QGuiApplication>
#include <QtGui/QWindow>
#include <QtGui/QScreen>
#include <qpa/qwindowsysteminterface.h>

LOG_MODULE_REGISTER(qzephyr_touch, LOG_LEVEL_INF);

namespace {

struct TouchState {
    int x = 0;
    int y = 0;
    bool pressed = false;
    bool sent_press = false;
};
TouchState g_state;

void process_event(input_event *evt, void *)
{
    static uint32_t evt_count = 0;
    ++evt_count;
    if (evt_count <= 10 || (evt_count % 50) == 0) {
        printk("[touch_evt #%u] type=%u code=%u value=%d sync=%d\n",
               evt_count, evt->type, evt->code, evt->value, evt->sync);
    }
    switch (evt->code) {
    case INPUT_ABS_X:
        g_state.x = evt->value;
        break;
    case INPUT_ABS_Y:
        g_state.y = evt->value;
        break;
    case INPUT_BTN_TOUCH:
        g_state.pressed = (evt->value != 0);
        break;
    default:
        return;
    }
    if (!evt->sync)
        return;

    const QPoint p(g_state.x, g_state.y);
    const bool pressed = g_state.pressed;
    const bool was_pressed = g_state.sent_press;

    Qt::MouseButtons buttons = pressed ? Qt::LeftButton : Qt::NoButton;
    QEvent::Type evType =
        (pressed && !was_pressed) ? QEvent::MouseButtonPress :
        (!pressed && was_pressed) ? QEvent::MouseButtonRelease :
        QEvent::MouseMove;
    Qt::MouseButton button =
        (evType == QEvent::MouseMove) ? Qt::NoButton : Qt::LeftButton;

    g_state.sent_press = pressed;

    // Find the single top-level QWindow this embedded app has.
    QWindow *target = nullptr;
    const auto windows = QGuiApplication::topLevelWindows();
    if (!windows.isEmpty())
        target = windows.constFirst();

    static uint32_t dispatched = 0;
    ++dispatched;
    if (dispatched <= 6) {
        printk("[touch] dispatch #%u type=%d target=%p pos=(%d,%d) btn=%d\n",
               dispatched, (int)evType, target, p.x(), p.y(),
               (int)button);
    }

    // Use AsynchronousDelivery -- the input subsystem invokes this
    // callback from its dedicated input thread, whose stack is sized
    // by CONFIG_INPUT_THREAD_STACK_SIZE.  Synchronous delivery would
    // walk the full QGuiApplication event-filter / scenegraph chain
    // on that thread and blow the stack at the depth Qt requires.
    // AsynchronousDelivery posts the event into the QPA queue and
    // returns; the main thread's qzephyr_drain_qpa_events() picks it
    // up via QWindowSystemInterface::sendWindowSystemEvents().
    QWindowSystemInterface::handleMouseEvent<QWindowSystemInterface::AsynchronousDelivery>(
            target, p, p, buttons, button, evType, Qt::NoModifier);
}

} // namespace

INPUT_CALLBACK_DEFINE(DEVICE_DT_GET(DT_CHOSEN(zephyr_touch)),
                      process_event, NULL);

// Strong def of the weak hook qeventdispatcher_zephyr.cpp calls each
// iteration of processEvents().  Drains the QPA window-system event
// queue so events posted by handleMouseEvent() actually reach QWindow.
extern "C" void qzephyr_drain_qpa_events()
{
    QWindowSystemInterface::sendWindowSystemEvents(QEventLoop::AllEvents);
}
```
