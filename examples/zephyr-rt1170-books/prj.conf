## CMakeLists.txt
```
# Zephyr wrapper for Qt 6.11's official "Books" SQL example on RT1170-EVKB.
# The Qt sample directory is consumed unmodified via qt_zephyr_app().
#
# Build:
#   QT_SAMPLE_DIR=$HOME/io/qt/release/Examples/Qt-6.11.1/sql/books \
#   west build -b mimxrt1170_evk@B/mimxrt1176/cm7 -p always \
#       qt5/qtbase/examples/zephyr-rt1170-books -- -DSHIELD=rk055hdmipi4ma0

cmake_minimum_required(VERSION 3.20.0)

set(CMAKE_CXX_LINK_LIBRARY_USING_WHOLE_ARCHIVE
    "LINKER:--push-state,--whole-archive"
    "<LINK_ITEM>"
    "LINKER:--pop-state")
set(CMAKE_CXX_LINK_LIBRARY_USING_WHOLE_ARCHIVE_SUPPORTED TRUE)

find_package(Zephyr REQUIRED HINTS $ENV{ZEPHYR_BASE})
project(qt_books LANGUAGES CXX C)

if(NOT DEFINED ENV{QT_SAMPLE_DIR})
    message(FATAL_ERROR
        "QT_SAMPLE_DIR is not set.  Point it at Qt's stock sql/books directory.")
endif()

list(APPEND CMAKE_MODULE_PATH "${ZEPHYR_QT_ZEPHYR_PORT_MODULE_DIR}/cmake")
include(QtZephyrApp)

qt_zephyr_app(
    APP_DIR $ENV{QT_SAMPLE_DIR}
    TARGET  books
)
```

## prj.conf
```kconfig
# Qt 6.11 "Books" SQL example on RT1170-EVKB

CONFIG_QT=y
CONFIG_QT_GUI=y
CONFIG_QT_WIDGETS=y
CONFIG_QT_SQL=y
CONFIG_QT_SVG=y
CONFIG_QT_EMBEDDED_ROBOTO_FONT=y

# C++ / libc (Stage 1 ABI)
CONFIG_CPP=y
CONFIG_STD_CPP17=y
CONFIG_CPP_EXCEPTIONS=y
CONFIG_GLIBCXX_LIBCPP=y
CONFIG_CPP_RTTI=y
CONFIG_PICOLIBC=n
CONFIG_NEWLIB_LIBC=y
CONFIG_POSIX_API=y
CONFIG_FPU=y

# Console
CONFIG_CONSOLE=y
CONFIG_UART_CONSOLE=y
CONFIG_PRINTK=y
CONFIG_STDOUT_CONSOLE=y

# Display + touch
CONFIG_DISPLAY=y
CONFIG_INPUT=y
CONFIG_INPUT_THREAD_STACK_SIZE=32768

# PXP double-buffer + landscape rotation
CONFIG_DMA=y
CONFIG_MCUX_ELCDIF_PXP=y
CONFIG_MCUX_ELCDIF_PXP_ROTATE_90=y

# Memory
CONFIG_HEAP_MEM_POOL_SIZE=16777216
CONFIG_NEWLIB_LIBC_ALIGNED_HEAP_SIZE=16777216
CONFIG_MAIN_STACK_SIZE=524288
CONFIG_ISR_STACK_SIZE=8192
CONFIG_IDLE_STACK_SIZE=4096
```

## src/main.cpp
```c
#include "bookwindow.h"

#include <QApplication>

#include <zephyr/kernel.h>
#include <zephyr/storage/disk_access.h>
#include <zephyr/fs/fs.h>
#include <ff.h>

extern "C" void qzephyr_sqlite_patch_vfs(void);

static FATFS fat_fs;
static struct fs_mount_t mp = {
    .type = FS_FATFS,
    .fs_data = &fat_fs,
};

static bool mount_sd()
{
    if (disk_access_init("SD") != 0) {
        printk("[books] disk_access_init failed\n");
        return false;
    }
    mp.mnt_point = "/SD:";
    if (fs_mount(&mp) != 0) {
        printk("[books] mount failed\n");
        return false;
    }
    printk("[books] SD card mounted at /SD:\n");
    return true;
}

int main(int /*argc_zephyr*/, char * /*argv_zephyr*/[])
{
    printk("\n[books] === boot ===\n");

    qzephyr_sqlite_patch_vfs();
    mount_sd();

    static char arg0[] = "books";
    static char *argv[] = { arg0, nullptr };
    int argc = 1;

    qputenv("QT_QPA_PLATFORM", "zephyr");
    QApplication app(argc, argv);

    BookWindow win;
    win.showFullScreen();

    return app.exec();
}
```

## src/bookwindow.cpp
```c
// Copyright (C) 2016 The Qt Company Ltd.
// SPDX-License-Identifier: LicenseRef-Qt-Commercial OR BSD-3-Clause

#include "bookwindow.h"
#include "bookdelegate.h"
#include "initdb.h"

#include <QApplication>
#include <QComboBox>
#include <QDataWidgetMapper>
#include <QGridLayout>
#include <QHeaderView>
#include <QLabel>
#include <QLineEdit>
#include <QMenu>
#include <QMenuBar>
#include <QMessageBox>
#include <QPainter>
#include <QScrollBar>
#include <QSpinBox>
#include <QSqlDatabase>
#include <QTableView>

BookWindow::BookWindow()
{
    if (!QSqlDatabase::drivers().contains("QSQLITE"))
        QMessageBox::critical(this, tr("Unable to load database"),
                              tr("This demo needs the SQLITE driver"));

    // Initialize the database:
    QSqlError err = initDb();
    if (err.type() != QSqlError::NoError) {
        showError(err);
        return;
    }

    // create the central widget for the window
    window = new QWidget(this);
    setCentralWidget(window);

    createLayout();

    createModel();

    // Populate the model
    if (!model->select()) {
        showError(model->lastError());
        return;
    }

    configureWidgets();

    // create the mappings between the UI elements and the SQL model
    createMappings();

    tableView->setCurrentIndex(model->index(0, 0));
    tableView->selectRow(0);

    createMenuBar();
}

void BookWindow::showError(const QSqlError &err)
{
    QMessageBox::critical(this, tr("Unable to initialize Database"),
                          tr("Error initializing database: %1").arg(err.text()));
}

void BookWindow::createLayout()
{
    tableView = new QTableView(window);

    gridLayout = new QGridLayout(window);

    titleLabel = new QLabel(tr("Title:"), window);
    titleLineEdit = new QLineEdit(window);
    authorLabel = new QLabel(tr("Author:"), window);
    authorComboBox = new QComboBox(window);
    genreLabel = new QLabel(tr("Genre:"), window);
    genreComboBox = new QComboBox(window);
    yearLabel = new QLabel(tr("Year:"), window);
    yearSpinBox = new QSpinBox(window);
    ratingLabel = new QLabel(tr("Rating:"), window);
    ratingComboBox = new QComboBox(window);

    gridLayout->addWidget(titleLabel, 0, 0, Qt::AlignRight);
    gridLayout->addWidget(titleLineEdit, 0, 1, 1, 3);
    gridLayout->addWidget(authorLabel, 1, 0, Qt::AlignRight);
    gridLayout->addWidget(authorComboBox, 1, 1);
    gridLayout->addWidget(yearLabel, 1, 2, Qt::AlignRight);
    gridLayout->addWidget(yearSpinBox, 1, 3);
    gridLayout->addWidget(genreLabel, 2, 0, Qt::AlignRight);
    gridLayout->addWidget(genreComboBox, 2, 1);
    gridLayout->addWidget(ratingLabel, 2, 2, Qt::AlignRight);
    gridLayout->addWidget(ratingComboBox, 2, 3);
    gridLayout->addWidget(tableView, 3, 0, 1, 4);
    gridLayout->setColumnStretch(1, 1000);
    gridLayout->setColumnStretch(3, 1000);
    gridLayout->setRowStretch(3, 1);

    gridLayout->setContentsMargins(18, 18, 18, 18);
    gridLayout->setSpacing(18);
}

void BookWindow::createModel()
{
    model = new QSqlRelationalTableModel(tableView);
    model->setEditStrategy(QSqlTableModel::OnFieldChange);
    model->setTable("books");

    authorIdx = model->fieldIndex("author");
    genreIdx = model->fieldIndex("genre");

    // Set the relations to the other database tables
    model->setRelation(authorIdx, QSqlRelation("authors", "id", "name"));
    model->setRelation(genreIdx, QSqlRelation("genres", "id", "name"));

    // Set the localised header captions
    model->setHeaderData(authorIdx, Qt::Horizontal, tr("Author Name"));
    model->setHeaderData(genreIdx, Qt::Horizontal, tr("Genre"));
    model->setHeaderData(model->fieldIndex("title"),
                         Qt::Horizontal, tr("Title"));
    model->setHeaderData(model->fieldIndex("year"), Qt::Horizontal, tr("Year"));
    model->setHeaderData(model->fieldIndex("rating"),
                         Qt::Horizontal, tr("Rating"));
}

void BookWindow::configureWidgets()
{
    tableView->setModel(model);
    tableView->setItemDelegate(new BookDelegate(model->fieldIndex("rating"), tableView));
    tableView->setColumnHidden(model->fieldIndex("id"), true);
    tableView->verticalHeader()->setVisible(false);
    tableView->setSelectionMode(QAbstractItemView::ExtendedSelection);
    tableView->setSelectionBehavior(QAbstractItemView::SelectRows);

    tableView->horizontalHeader()->setSectionResizeMode(QHeaderView::Stretch);
    tableView->verticalHeader()->setSectionResizeMode(QHeaderView::ResizeToContents);

    authorComboBox->setModel(model->relationModel(authorIdx));
    authorComboBox->setModelColumn(model->relationModel(authorIdx)->fieldIndex("name"));

    genreComboBox->setModel(model->relationModel(genreIdx));
    genreComboBox->setModelColumn(model->relationModel(genreIdx)->fieldIndex("name"));

    yearSpinBox->setMaximum(9999);

    ratingComboBox->setItemDelegate(new BookDelegate(0, this));
    ratingComboBox->setLabelDrawingMode(QComboBox::LabelDrawingMode::UseDelegate);
    ratingComboBox->addItems({"0", "1", "2", "3", "4", "5"});

    ratingComboBox->setIconSize(iconSize());
}

void BookWindow::createMappings()
{
    QDataWidgetMapper *mapper = new QDataWidgetMapper(this);
    mapper->setModel(model);
    mapper->setItemDelegate(new BookDelegate(model->fieldIndex("rating"), this));
    mapper->addMapping(titleLineEdit, model->fieldIndex("title"));
    mapper->addMapping(yearSpinBox, model->fieldIndex("year"));
    mapper->addMapping(authorComboBox, authorIdx);
    mapper->addMapping(genreComboBox, genreIdx);
    mapper->addMapping(ratingComboBox, model->fieldIndex("rating"), "currentIndex");
    connect(tableView->selectionModel(),
            &QItemSelectionModel::currentRowChanged,
            mapper,
            &QDataWidgetMapper::setCurrentModelIndex
            );
}

void BookWindow::createMenuBar()
{
    QAction *quitAction = new QAction(tr("&Quit"), this);
    QAction *aboutAction = new QAction(tr("&About"), this);
    QAction *aboutQtAction = new QAction(tr("&About Qt"), this);

    QMenu *fileMenu = menuBar()->addMenu(tr("&File"));
    fileMenu->addAction(quitAction);

    QMenu *helpMenu = menuBar()->addMenu(tr("&Help"));
    helpMenu->addAction(aboutAction);
    helpMenu->addAction(aboutQtAction);

    connect(quitAction, &QAction::triggered, qApp, &QCoreApplication::quit);
    connect(aboutAction, &QAction::triggered, this, &BookWindow::about);
    connect(aboutQtAction, &QAction::triggered, qApp, &QApplication::aboutQt);
}

void BookWindow::about()
{
    QMessageBox::about(this, tr("About Books"),
            tr("<p>The <b>Books</b> example shows how to use Qt SQL classes "
               "with a model/view framework."));
}
```

## src/initdb.h
```c
#ifndef INITDB_H
#define INITDB_H

#include <QDate>
#include <QSqlDatabase>
#include <QSqlError>
#include <QSqlQuery>

#include <zephyr/kernel.h>

inline void addBook(QSqlQuery &q, const QString &title, int year, const QVariant &authorId,
             const QVariant &genreId, int rating)
{
    q.addBindValue(title);
    q.addBindValue(year);
    q.addBindValue(authorId);
    q.addBindValue(genreId);
    q.addBindValue(rating);
    q.exec();
}

inline QVariant addGenre(QSqlQuery &q, const QString &name)
{
    q.addBindValue(name);
    q.exec();
    return q.lastInsertId();
}

inline QVariant addAuthor(QSqlQuery &q, const QString &name, QDate birthdate)
{
    q.addBindValue(name);
    q.addBindValue(birthdate);
    q.exec();
    return q.lastInsertId();
}

const auto BOOKS_SQL = QLatin1String(R"(
    create table books(id integer primary key, title varchar, author integer,
                       genre integer, year integer, rating integer)
    )");

const auto AUTHORS_SQL =  QLatin1String(R"(
    create table authors(id integer primary key, name varchar, birthdate date)
    )");

const auto GENRES_SQL = QLatin1String(R"(
    create table genres(id integer primary key, name varchar)
    )");

const auto INSERT_AUTHOR_SQL = QLatin1String(R"(
    insert into authors(name, birthdate) values(?, ?)
    )");

const auto INSERT_BOOK_SQL = QLatin1String(R"(
    insert into books(title, year, author, genre, rating)
                      values(?, ?, ?, ?, ?)
    )");

const auto INSERT_GENRE_SQL = QLatin1String(R"(
    insert into genres(name) values(?)
    )");

inline QSqlError initDb(const QString &dbPath = QStringLiteral("/SD:/books.db"))
{
    QSqlDatabase db = QSqlDatabase::addDatabase("QSQLITE");
    db.setDatabaseName(dbPath);
    printk("[books] opening DB: %s\n", qPrintable(dbPath));

    if (!db.open())
        return db.lastError();

    QSqlQuery q;
    q.exec("PRAGMA journal_mode=MEMORY");

    QStringList tables = db.tables();
    if (tables.contains("books", Qt::CaseInsensitive)
        && tables.contains("authors", Qt::CaseInsensitive)) {
        printk("[books] existing DB found, skipping init\n");
        return QSqlError();
    }
    printk("[books] creating tables + inserting initial data\n");

    if (!q.exec(BOOKS_SQL))
        return q.lastError();
    if (!q.exec(AUTHORS_SQL))
        return q.lastError();
    if (!q.exec(GENRES_SQL))
        return q.lastError();

    if (!q.prepare(INSERT_AUTHOR_SQL))
        return q.lastError();
    QVariant asimovId = addAuthor(q, QLatin1String("Isaac Asimov"), QDate(1920, 2, 1));
    QVariant greeneId = addAuthor(q, QLatin1String("Graham Greene"), QDate(1904, 10, 2));
    QVariant pratchettId = addAuthor(q, QLatin1String("Terry Pratchett"), QDate(1948, 4, 28));

    if (!q.prepare(INSERT_GENRE_SQL))
        return q.lastError();
    QVariant sfiction = addGenre(q, QLatin1String("Science Fiction"));
    QVariant fiction = addGenre(q, QLatin1String("Fiction"));
    QVariant fantasy = addGenre(q, QLatin1String("Fantasy"));

    if (!q.prepare(INSERT_BOOK_SQL))
        return q.lastError();
    addBook(q, QLatin1String("Foundation"), 1951, asimovId, sfiction, 3);
    addBook(q, QLatin1String("Foundation and Empire"), 1952, asimovId, sfiction, 4);
    addBook(q, QLatin1String("Second Foundation"), 1953, asimovId, sfiction, 3);
    addBook(q, QLatin1String("Foundation's Edge"), 1982, asimovId, sfiction, 3);
    addBook(q, QLatin1String("Foundation and Earth"), 1986, asimovId, sfiction, 4);
    addBook(q, QLatin1String("Prelude to Foundation"), 1988, asimovId, sfiction, 3);
    addBook(q, QLatin1String("Forward the Foundation"), 1993, asimovId, sfiction, 3);
    addBook(q, QLatin1String("The Power and the Glory"), 1940, greeneId, fiction, 4);
    addBook(q, QLatin1String("The Third Man"), 1950, greeneId, fiction, 5);
    addBook(q, QLatin1String("Our Man in Havana"), 1958, greeneId, fiction, 4);
    addBook(q, QLatin1String("Guards! Guards!"), 1989, pratchettId, fantasy, 3);
    addBook(q, QLatin1String("Night Watch"), 2002, pratchettId, fantasy, 3);
    addBook(q, QLatin1String("Going Postal"), 2004, pratchettId, fantasy, 3);

    return QSqlError();
}

#endif
```
