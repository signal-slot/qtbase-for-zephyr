## CMakeLists.txt
```
# SQLite in-memory test on RT1170-EVKB
#
# Build:
#   west build -b mimxrt1170_evk@B/mimxrt1176/cm7 -p always \
#       qt5/qtbase/examples/zephyr-rt1170-sqlite -- -DSHIELD=rk055hdmipi4ma0

cmake_minimum_required(VERSION 3.20.0)

set(CMAKE_CXX_LINK_LIBRARY_USING_WHOLE_ARCHIVE
    "LINKER:--push-state,--whole-archive"
    "<LINK_ITEM>"
    "LINKER:--pop-state")
set(CMAKE_CXX_LINK_LIBRARY_USING_WHOLE_ARCHIVE_SUPPORTED TRUE)

find_package(Zephyr REQUIRED HINTS $ENV{ZEPHYR_BASE})
project(qt_sqlite LANGUAGES CXX C)

list(APPEND CMAKE_PREFIX_PATH "$ENV{QT_ZEPHYR_PREFIX}")
find_package(Qt6 REQUIRED COMPONENTS Core Gui Widgets Sql)

target_sources(app PRIVATE src/main.cpp src/posix_stubs.c src/sqlite_vfs_patch.c)
target_include_directories(app PRIVATE
    ${CMAKE_CURRENT_SOURCE_DIR}/../../src/3rdparty/sqlite
)
target_link_libraries(app PRIVATE
    Qt6::Sql
    Qt6::Widgets
    Qt6::Gui
    Qt6::Core
)

# Wrap lseek/read to fix FatFS's refusal to seek beyond EOF (POSIX requires it)
zephyr_link_libraries(-Wl,--wrap=lseek,--wrap=read)
```

## prj.conf
```kconfig
# SQLite on RT1170-EVKB (in-memory + file-based on SD card)

CONFIG_QT=y
CONFIG_QT_GUI=y
CONFIG_QT_WIDGETS=y
CONFIG_QT_SQL=y
CONFIG_QT_EMBEDDED_ROBOTO_FONT=y

# C++ / libc (Stage 1 ABI)
CONFIG_CPP=y
CONFIG_STD_CPP17=y
CONFIG_CPP_EXCEPTIONS=y
CONFIG_GLIBCXX_LIBCPP=y
CONFIG_CPP_RTTI=y
CONFIG_PICOLIBC=n
CONFIG_NEWLIB_LIBC=y
CONFIG_POSIX_API=y
CONFIG_POSIX_DEVICE_IO=y
CONFIG_FPU=y

# Console
CONFIG_CONSOLE=y
CONFIG_UART_CONSOLE=y
CONFIG_PRINTK=y
CONFIG_STDOUT_CONSOLE=y

# Display + touch
CONFIG_DISPLAY=y
CONFIG_INPUT=y
CONFIG_INPUT_THREAD_STACK_SIZE=32768

# PXP double-buffer + landscape rotation
CONFIG_DMA=y
CONFIG_MCUX_ELCDIF_PXP=y
CONFIG_MCUX_ELCDIF_PXP_ROTATE_90=y

# SD card (FAT filesystem for file-based SQLite DB)
CONFIG_DISK_ACCESS=y
CONFIG_DISK_DRIVER_SDMMC=y
CONFIG_FILE_SYSTEM=y
CONFIG_FAT_FILESYSTEM_ELM=y
CONFIG_FS_FATFS_LFN=y
CONFIG_FS_FATFS_MAX_LFN=255

# Memory
CONFIG_HEAP_MEM_POOL_SIZE=16777216
CONFIG_NEWLIB_LIBC_ALIGNED_HEAP_SIZE=16777216
CONFIG_MAIN_STACK_SIZE=524288
CONFIG_ISR_STACK_SIZE=8192
CONFIG_IDLE_STACK_SIZE=4096
```

## boards/mimxrt1170_evk_mimxrt1176_cm7.overlay
```dts
&usdhc1 {
	status = "okay";
};
```

## src/main.cpp
```c
#include <QApplication>
#include <QLabel>
#include <QVBoxLayout>
#include <QSqlDatabase>
#include <QSqlQuery>
#include <QSqlError>

#include <zephyr/kernel.h>

int main(int /*argc_zephyr*/, char * /*argv_zephyr*/[])
{
    printk("\n[sqlite] === boot ===\n");

    static char arg0[] = "sqlite";
    static char *argv[] = { arg0, nullptr };
    int argc = 1;

    qputenv("QT_QPA_PLATFORM", "zephyr");
    printk("[sqlite] creating QApplication...\n");
    QApplication app(argc, argv);
    printk("[sqlite] QApplication created\n");

    QWidget w;
    auto *layout = new QVBoxLayout(&w);
    auto *titleLabel = new QLabel("SQLite on Zephyr");
    titleLabel->setStyleSheet("font-size: 32px; font-weight: bold;");
    layout->addWidget(titleLabel);

    auto *resultLabel = new QLabel;
    resultLabel->setStyleSheet("font-size: 20px;");
    resultLabel->setWordWrap(true);
    layout->addWidget(resultLabel);

    w.showFullScreen();

    QString result;

    QSqlDatabase db = QSqlDatabase::addDatabase("QSQLITE");
    db.setDatabaseName(":memory:");

    if (!db.open()) {
        result = QString("FAIL: %1").arg(db.lastError().text());
        printk("[sqlite] open failed: %s\n", qPrintable(db.lastError().text()));
    } else {
        printk("[sqlite] in-memory database opened\n");

        QSqlQuery q;
        q.exec("CREATE TABLE sensors (id INTEGER PRIMARY KEY, name TEXT, value REAL)");
        q.exec("INSERT INTO sensors (name, value) VALUES ('temperature', 23.5)");
        q.exec("INSERT INTO sensors (name, value) VALUES ('humidity', 61.2)");
        q.exec("INSERT INTO sensors (name, value) VALUES ('pressure', 1013.25)");

        q.exec("SELECT name, value FROM sensors");
        QStringList rows;
        while (q.next()) {
            QString row = QString("%1 = %2").arg(q.value(0).toString(),
                                                  q.value(1).toString());
            rows << row;
            printk("[sqlite] %s\n", qPrintable(row));
        }

        q.exec("SELECT COUNT(*) FROM sensors");
        q.next();
        int count = q.value(0).toInt();
        printk("[sqlite] %d rows in table\n", count);

        result = QString("OK: %1 rows\n%2").arg(count).arg(rows.join("\n"));
    }

    resultLabel->setText(result);

    return app.exec();
}
```

## src/posix_stubs.c
```c
#include <sys/stat.h>
#include <string.h>
#include <errno.h>
#include <unistd.h>
#include <fcntl.h>

/*
 * Zephyr FatFS lseek rejects seeks beyond EOF (returns EINVAL).
 * POSIX requires lseek beyond EOF to succeed (sparse file semantics).
 * SQLite relies on this: it seeks to offset 24 on a 0-byte file to read
 * the change counter. We wrap lseek to track a "virtual position" when
 * the seek target exceeds the current file size. Subsequent reads from
 * that position return 0 (EOF).
 */
extern off_t __real_lseek(int fd, off_t offset, int whence);
extern ssize_t __real_read(int fd, void *buf, size_t count);

#define MAX_TRACKED_FDS 8
static struct {
    int fd;
    off_t virt_pos;
} s_virt[MAX_TRACKED_FDS];

static int virt_slot(int fd)
{
    for (int i = 0; i < MAX_TRACKED_FDS; i++)
        if (s_virt[i].fd == fd)
            return i;
    return -1;
}

static int virt_alloc(int fd)
{
    int slot = virt_slot(fd);
    if (slot >= 0) return slot;
    for (int i = 0; i < MAX_TRACKED_FDS; i++) {
        if (s_virt[i].fd == 0) {
            s_virt[i].fd = fd;
            s_virt[i].virt_pos = -1;
            return i;
        }
    }
    return -1;
}

off_t __wrap_lseek(int fd, off_t offset, int whence)
{
    off_t result = __real_lseek(fd, offset, whence);
    if (result >= 0) {
        int slot = virt_slot(fd);
        if (slot >= 0)
            s_virt[slot].virt_pos = -1;
        return result;
    }

    if (errno == EINVAL && whence == SEEK_SET) {
        struct stat st;
        if (fstat(fd, &st) == 0 && offset > st.st_size) {
            __real_lseek(fd, 0, SEEK_END);
            int slot = virt_alloc(fd);
            if (slot >= 0)
                s_virt[slot].virt_pos = offset;
            return offset;
        }
    }
    return -1;
}

ssize_t __wrap_read(int fd, void *buf, size_t count)
{
    int slot = virt_slot(fd);
    if (slot >= 0 && s_virt[slot].virt_pos >= 0) {
        return 0;
    }
    return __real_read(fd, buf, count);
}

/* --- POSIX stubs for functions missing in Zephyr --- */

int lstat(const char *path, struct stat *buf)
{
    return stat(path, buf);
}

ssize_t readlink(const char *path, char *buf, size_t bufsiz)
{
    (void)path; (void)buf; (void)bufsiz;
    errno = EINVAL;
    return -1;
}

char *getcwd(char *buf, size_t size)
{
    if (size < 2) {
        errno = ERANGE;
        return NULL;
    }
    buf[0] = '/';
    buf[1] = '\0';
    return buf;
}

int flock(int fd, int operation)
{
    (void)fd; (void)operation;
    return 0;
}

int access(const char *path, int amode)
{
    struct stat st;
    if (stat(path, &st) != 0)
        return -1;
    (void)amode;
    return 0;
}

int utimes(const char *path, const void *times)
{
    (void)path; (void)times;
    return 0;
}

unsigned int geteuid(void)
{
    return 1000;
}

unsigned int getuid(void)
{
    return 1000;
}
```

## src/sqlite_vfs_patch.c
```c
#include <zephyr/kernel.h>
#include <unistd.h>
#include <fcntl.h>
#include <errno.h>
#include <sqlite3.h>

static ssize_t zephyr_pread(int fd, void *buf, size_t count, off_t offset)
{
    off_t old = lseek(fd, 0, SEEK_CUR);
    if (old == (off_t)-1)
        return -1;
    if (lseek(fd, offset, SEEK_SET) == (off_t)-1) {
        lseek(fd, old, SEEK_SET);
        return -1;
    }
    ssize_t n = read(fd, buf, count);
    int saved = errno;
    lseek(fd, old, SEEK_SET);
    errno = saved;
    return n;
}

static ssize_t zephyr_pwrite(int fd, const void *buf, size_t count, off_t offset)
{
    off_t old = lseek(fd, 0, SEEK_CUR);
    if (old == (off_t)-1)
        return -1;
    if (lseek(fd, offset, SEEK_SET) == (off_t)-1)
        return -1;
    ssize_t n = write(fd, buf, count);
    int saved = errno;
    lseek(fd, old, SEEK_SET);
    errno = saved;
    return n;
}

void sqlite_patch_vfs_for_zephyr(void)
{
    sqlite3_initialize();

    sqlite3_vfs *vfs = sqlite3_vfs_find("unix");
    if (!vfs || !vfs->xSetSystemCall)
        return;

    vfs->xSetSystemCall(vfs, "pread", (sqlite3_syscall_ptr)zephyr_pread);
    vfs->xSetSystemCall(vfs, "pwrite", (sqlite3_syscall_ptr)zephyr_pwrite);

    sqlite3_vfs *none = sqlite3_vfs_find("unix-none");
    if (none) {
        if (none->xSetSystemCall) {
            none->xSetSystemCall(none, "pread", (sqlite3_syscall_ptr)zephyr_pread);
            none->xSetSystemCall(none, "pwrite", (sqlite3_syscall_ptr)zephyr_pwrite);
        }
        sqlite3_vfs_register(none, 1);
    }
}
```
